AUTOSAR XML (schema 4-2-1)
package /ActiveEcuC
  module config EcuC: implementation-config-variant=VARIANT-PRE-COMPILE, module-description=EcuC_Impl
    EcucPduCollection: PduIdTypeEnum=UINT8, PduLengthTypeEnum=UINT16
      213 x Pdu, all with J1939Requestable=false:
        Cluster_Info1_FD1_oFD1_CAN_09a60c78_Rx: PduLength=8
        VeyDynamics_Data_oFD1_CAN_7165bfa2_Tx: PduLength=8
        Suspension_Data_oFD1_CAN_caf99590_Tx: PduLength=8, SysTPduToFrameMappingRef=Suspension_Data
        TesterFunctionalReq_FD1_oFD1_CAN_20_f5d6c35a_Rx: PduLength=7
        Cluster_Info_3_FD1_oFD1_CAN_378fba0b_Rx: PduLength=8
        Yaw_Data_FD1_oFD1_CAN_f318059c_Rx: PduLength=8
        Suspension_Data_oFD1_CAN_ac9146d5_Tx: PduLength=8
        Personality_VDM_Data_oFD1_CAN_da4f0f9f_Tx: PduLength=8, SysTPduToFrameMappingRef=Personality_VDM_Data
        VeyDynamics_Data_oFD1_CAN_011a6ccb_Tx: PduLength=8, SysTPduToFrameMappingRef=VeyDynamics_Data
        TesterFunctionalReq_FD1_oFD1_CAN_20_4ec2aa8a_Rx: PduLength=7
        TorqueDataEngFlags_oFD1_CAN_15b85eed_Rx: PduLength=8
        BrakeSnData_3_oFD1_CAN_1f773362_Rx: PduLength=8
        TrailerInfo_FD1_oFD1_CAN_edb4d20a_Rx: PduLength=8, SysTPduToFrameMappingRef=TrailerInfo_FD1
        TesterPhysicalResVDM_oFD1_CAN_20_7bac9480_Tx: PduLength=8
        BrakeSysFeatures_3_oFD1_CAN_e000acae_Rx: PduLength=8
        TransGearData_oFD1_CAN_999d0f2a_Rx: PduLength=8, SysTPduToFrameMappingRef=TransGearData
        Cluster_Info1_FD1_oFD1_CAN_0bb7d4da_Rx: PduLength=8, SysTPduToFrameMappingRef=Cluster_Info1_FD1
        TransGearData_oFD1_CAN_5a12f1e0_Rx: PduLength=8
        BrakeSysFeatures_2_oFD1_CAN_0fc2c790_Rx: PduLength=8
        TesterPhysicalResVDM_Tp_oFD1_CAN_f3f09210_Tx: PduLength=64, SysTPduToFrameMappingRef=TesterPhysicalResVDM_Tp
        TesterFunctionalReq_FD1_Tp_oFD1_CAN_7d8ac5ca_Rx: PduLength=64, SysTPduToFrameMappingRef=TesterFunctionalReq_FD1_Tp
        VehicleOperatingModes_oFD1_CAN_97ffcb40_Rx: PduLength=8
        ABS_BrkBst_Data_oFD1_CAN_e42dd9a6_Rx: PduLength=8
        TesterFunctionalReq_FD1_Tp_oFD1_CAN_20_0073ea8e_Rx: PduLength=8, SysTPduToFrameMappingRef=TesterFunctionalReq_FD1_Tp
        BrakeSnData_4_oFD1_CAN_fdab281b_Rx: PduLength=8
        Accel_Data_FD1_oFD1_CAN_de731ce0_Rx: PduLength=8, SysTPduToFrameMappingRef=Accel_Data_FD1
        WheelSpeed_oFD1_CAN_e54159b0_Rx: PduLength=8
        TesterPhysicalResVDM_oFD1_CAN_20_42f2453a_Tx: PduLength=8
        DesiredTorqBrk_oFD1_CAN_ad57be28_Rx: PduLength=8
        Climate_Control_Data_FD1_oFD1_CAN_9189403a_Rx: PduLength=8, SysTPduToFrameMappingRef=Climate_Control_Data_FD1
        EngineData_6_oFD1_CAN_cebf9719_Rx: PduLength=8
        Cluster_Info_3_FD1_oFD1_CAN_5c17b81b_Rx: PduLength=8, SysTPduToFrameMappingRef=Cluster_Info_3_FD1
        PowertrainData_9_oFD1_CAN_10387e6b_Rx: PduLength=8
        Yaw_Data_FD1_oFD1_CAN_b8d5ae0e_Rx: PduLength=8, SysTPduToFrameMappingRef=Yaw_Data_FD1
        TrailerBrakeInfo_FD1_oFD1_CAN_3021d77f_Rx: PduLength=8, SysTPduToFrameMappingRef=TrailerBrakeInfo_FD1
        TesterFunctionalReq_FD1_oFD1_CAN_34637193_Rx: PduLength=62
        Personality_VDM_Data_oFD1_CAN_945ded88_Tx: PduLength=8
        TesterPhysicalResVDM_Tp_oFD1_CAN_20_c5470957_Tx: PduLength=8, SysTPduToFrameMappingRef=TesterPhysicalResVDM_Tp
        Climate_Control_Data_FD1_oFD1_CAN_f1463698_Rx: PduLength=8
        TesterPhysicalResVDM_oFD1_CAN_6c3d0be2_Tx: PduLength=64
        TesterFunctionalReq_FD1_oFD1_CAN_0aafacc4_Rx: PduLength=62
        Accel_Data_FD1_oFD1_CAN_3bd4ed3e_Rx: PduLength=8
        EngBrakeData_oFD1_CAN_04bbeb79_Rx: PduLength=8
        EngVehicleSpThrottle2_oFD1_CAN_ac1a144b_Rx: PduLength=8
        TrailerInfo_FD1_oFD1_CAN_6acffff2_Rx: PduLength=8
        TrailerBrakeInfo_FD1_oFD1_CAN_e983cb78_Rx: PduLength=8
        EngVehicleSpThrottle_oFD1_CAN_cbf55901_Rx: PduLength=8
        TesterPhysicalResVDM_oFD1_CAN_b5d0892d_Tx: PduLength=64
        BrakeSysFeatures_oFD1_CAN_ecd91b70_Rx: PduLength=8
        PARSEDFuncGWM_ECG_FD1_Tp_oFD1_CAN_20_d331e649_Rx: PduLength=8, SysTPduToFrameMappingRef=PARSEDFuncGWM_ECG_FD1_Tp
        OTAPhysGWM_ECGtoVDM_Tp_oFD1_CAN_20_43e367ad_Rx: PduLength=8, SysTPduToFrameMappingRef=OTAPhysGWM_ECGtoVDM_Tp
        PARSEDPhysGWM_ECGtoVDM_oFD1_CAN_20_d523cdbf_Rx: PduLength=8
        OTAPhysVDMtoGWM_ECG_oFD1_CAN_59349f62_Tx: PduLength=64
        OTAFuncGWM_ECG_FD1_Tp_oFD1_CAN_20_eee4a57a_Rx: PduLength=8, SysTPduToFrameMappingRef=OTAFuncGWM_ECG_FD1_Tp
        OTAFuncGWM_ECG_FD1_oFD1_CAN_e28a36a6_Rx: PduLength=62
        PARSEDFuncGWM_ECG_FD1_oFD1_CAN_87a5f9fe_Rx: PduLength=62
        OTAPhysVDMtoGWM_ECG_Tp_oFD1_CAN_cd656362_Tx: PduLength=64, SysTPduToFrameMappingRef=OTAPhysVDMtoGWM_ECG_Tp
        PARSEDFuncGWM_ECG_FD1_oFD1_CAN_20_fb33e39e_Rx: PduLength=7
        OTAPhysGWM_ECGtoVDM_oFD1_CAN_e46027a4_Rx: PduLength=64
        OTAPhysVDMtoGWM_ECG_Tp_oFD1_CAN_20_1ff00260_Tx: PduLength=8, SysTPduToFrameMappingRef=OTAPhysVDMtoGWM_ECG_Tp
        OTAFuncGWM_ECG_FD1_oFD1_CAN_20_7e2f6a2b_Rx: PduLength=7
        OTAPhysGWM_ECGtoVDM_oFD1_CAN_a94ef157_Rx: PduLength=64
        OTAPhysVDMtoGWM_ECG_oFD1_CAN_20_cf36a935_Tx: PduLength=8
        PARSEDPhysGWM_ECGtoVDM_Tp_oFD1_CAN_5d7fcb2f_Rx: PduLength=64, SysTPduToFrameMappingRef=PARSEDPhysGWM_ECGtoVDM_Tp
        OTAFuncGWM_ECG_FD1_oFD1_CAN_55f0b986_Rx: PduLength=62
        OTAFuncGWM_ECG_FD1_Tp_oFD1_CAN_f6736cbb_Rx: PduLength=64, SysTPduToFrameMappingRef=OTAFuncGWM_ECG_FD1_Tp
        PARSEDPhysGWM_ECGtoVDM_Tp_oFD1_CAN_20_fc0ed3f8_Rx: PduLength=8, SysTPduToFrameMappingRef=PARSEDPhysGWM_ECGtoVDM_Tp
        OTAPhysGWM_ECGtoVDM_oFD1_CAN_20_6ead9635_Rx: PduLength=8
        PARSEDPhysVDMtoGWM_ECG_Tp_oFD1_CAN_76eb38e8_Tx: PduLength=64, SysTPduToFrameMappingRef=PARSEDPhysVDMtoGWM_ECG_Tp
        OTAPhysVDMtoGWM_ECG_oFD1_CAN_20_453965f2_Tx: PduLength=8
        PARSEDPhysGWM_ECGtoVDM_oFD1_CAN_81b5d1ad_Rx: PduLength=64
        OTAPhysGWM_ECGtoVDM_Tp_oFD1_CAN_e6f190a5_Rx: PduLength=64, SysTPduToFrameMappingRef=OTAPhysGWM_ECGtoVDM_Tp
        PARSEDPhysVDMtoGWM_ECG_oFD1_CAN_20_feb73e78_Tx: PduLength=8
        PARSEDPhysVDMtoGWM_ECG_oFD1_CAN_5d651697_Tx: PduLength=64
        PARSEDPhysVDMtoGWM_ECG_Tp_oFD1_CAN_20_a01db635_Tx: PduLength=8, SysTPduToFrameMappingRef=PARSEDPhysVDMtoGWM_ECG_Tp
        OTAPhysVDMtoGWM_ECG_oFD1_CAN_38b0e09e_Tx: PduLength=64
        PARSEDFuncGWM_ECG_FD1_Tp_oFD1_CAN_736fe50e_Rx: PduLength=64, SysTPduToFrameMappingRef=PARSEDFuncGWM_ECG_FD1_Tp
        PARSEDPushVDMtoGWM_ECG_oFD1_CAN_3f1153d6_Tx: PduLength=8, SysTPduToFrameMappingRef=PARSEDPushVDMtoGWM_ECG_Tp
        PARSEDPushVDMtoGWM_ECG_oFD1_CAN_d23a2b72_Tx: PduLength=8
        PARSEDPushVDMtoGWM_ECG_Tp_oFD1_CAN_48fe2ef7_Tx: PduLength=8, SysTPduToFrameMappingRef=PARSEDPushVDMtoGWM_ECG_Tp
        PARSEDPushVDMtoGWM_ECG_oFD1_CAN_20_212ab39a_Tx: PduLength=8
        PARSEDPushVDMtoGWM_ECG_Tp_oFD1_CAN_20_c622037a_Tx: PduLength=8, SysTPduToFrameMappingRef=PARSEDPushVDMtoGWM_ECG_Tp
        PARSEDPushFcGWM_ECGtoVDM_oFD1_CAN_20_d027b666_Rx: PduLength=8
        PARSEDPushFcGWM_ECGtoVDM_oFD1_CAN_0f300a39_Rx: PduLength=64
        PARSEDPhysGWM_ECGtoVDM_oFD1_CAN_4ecdd4d6_Rx: PduLength=64
        DeliveryVersion_oFD1_CAN_f2797042_Rx: PduLength=10
        PARSEDPhysVDMtoGWM_ECG_oFD1_CAN_beb7bae3_Tx: PduLength=64
        PARSEDPushFcGWM_ECGtoVDM_Tp_oFD1_CAN_20_b5f0b966_Rx: PduLength=8, SysTPduToFrameMappingRef=PARSEDPushFcGWM_ECGtoVDM_Tp
        PARSEDPushFcGWM_ECGtoVDM_oFD1_CAN_163cbc7d_Rx: PduLength=64
        PARSEDFuncGWM_ECG_FD1_oFD1_CAN_6ef83f88_Rx: PduLength=62
        PARSEDPushFcGWM_ECGtoVDM_Tp_oFD1_CAN_587bb0f6_Rx: PduLength=8, SysTPduToFrameMappingRef=PARSEDPushFcGWM_ECGtoVDM_Tp
        Personality_APIM_Data3_FD1_oFD1_CAN_6a70d2f9_Rx: PduLength=8, SysTPduToFrameMappingRef=Personality_APIM_Data3_FD1
        OBS_Load_Data_oFD1_CAN_ad23809a_Tx: PduLength=8
        Personality_APIM_Data3_FD1_oFD1_CAN_22ff714d_Rx: PduLength=8
        OBS_Load_Data_oFD1_CAN_c786b0d6_Tx: PduLength=8, SysTPduToFrameMappingRef=OBS_Load_Data
        OTAFuncGWM_ECG_FD1_oFD1_CAN_20_3e0a54c8_Rx: PduLength=7
        OTAPhysGWM_ECGtoVDM_oFD1_CAN_20_a63850b5_Rx: PduLength=8
        PARSEDFuncGWM_ECG_FD1_oFD1_CAN_20_5796ce06_Rx: PduLength=7, SysTPduToFrameMappingRef=PARSEDFuncGWM_ECG_FD1_Tp
        PARSEDPushVDMtoGWM_ECG_oFD1_CAN_20_c0a22867_Tx: PduLength=8
        PARSEDPhysGWM_ECGtoVDM_oFD1_CAN_20_da8d2398_Rx: PduLength=8
        PARSEDPhysVDMtoGWM_ECG_oFD1_CAN_20_b383da18_Tx: PduLength=8
        SymKeyPhysVDMtoGWM_ECG_oFD1_CAN_91c68ee1_Tx: PduLength=64
        Tire_Pressure_Data_oFD1_CAN_5932ebbb_Rx: PduLength=8
        TesterPhysicalReqVDM_oFD1_CAN_cd114f3d_Rx: PduLength=64
        GGCC_Config_Mgmt_ID_1_oFD1_CAN_27dd2c2c_Rx: PduLength=8
        TesterPhysicalReqVDM_oFD1_CAN_0c61bea9_Rx: PduLength=64
        SymKeyPhysGWM_ECGtoVDM_Tp_oFD1_CAN_fb442d41_Rx: PduLength=64, SysTPduToFrameMappingRef=SymKeyPhysGWM_ECGtoVDM_Tp
        SymKeyPhysVDMtoGWM_ECG_oFD1_CAN_20_588cd816_Tx: PduLength=8
        SteeringPinion_Data_FD1_oFD1_CAN_b099bee6_Rx: PduLength=8, SysTPduToFrameMappingRef=SteeringPinion_Data_FD1
        SymKeyPhysGWM_ECGtoVDM_Tp_oFD1_CAN_20_0768883a_Rx: PduLength=8, SysTPduToFrameMappingRef=SymKeyPhysGWM_ECGtoVDM_Tp
        SymKeyPhysGWM_ECGtoVDM_oFD1_CAN_4d1649db_Rx: PduLength=64
        SymKeyPhysVDMtoGWM_ECG_oFD1_CAN_1f711d68_Tx: PduLength=64
        SymKeyPhysGWM_ECGtoVDM_oFD1_CAN_20_a4ac9af3_Rx: PduLength=8
        SymKeyPhysGWM_ECGtoVDM_oFD1_CAN_ef0b735d_Rx: PduLength=64
        SymKeyPhysVDMtoGWM_ECG_oFD1_CAN_20_cda26373_Tx: PduLength=8
        Personality_BCM2_Data_oFD1_CAN_1d6a7788_Rx: PduLength=8
        SymKeyPhysVDMtoGWM_ECG_Tp_oFD1_CAN_d0d0de86_Tx: PduLength=64, SysTPduToFrameMappingRef=SymKeyPhysVDMtoGWM_ECG_Tp
        SymKeyPhysVDMtoGWM_ECG_Tp_oFD1_CAN_20_5b7bedf7_Tx: PduLength=8, SysTPduToFrameMappingRef=SymKeyPhysVDMtoGWM_ECG_Tp
        SteeringPinion_Data_FD1_oFD1_CAN_837112cd_Rx: PduLength=8
        TesterPhysicalReqVDM_oFD1_CAN_20_1649b566_Rx: PduLength=8
        TesterPhysicalReqVDM_oFD1_CAN_20_c5526059_Rx: PduLength=8
        TesterPhysicalReqVDM_Tp_oFD1_CAN_20_34d7a63c_Rx: PduLength=8, SysTPduToFrameMappingRef=TesterPhysicalReqVDM_Tp
        TesterPhysicalReqVDM_Tp_oFD1_CAN_9e15b3f6_Rx: PduLength=64, SysTPduToFrameMappingRef=TesterPhysicalReqVDM_Tp
        BodyInfo_3_oFD1_CAN_27b26844_Rx: PduLength=8
        SymKeyPhysGWM_ECGtoVDM_oFD1_CAN_20_73182bd1_Rx: PduLength=8
        EngineData_12_oFD1_CAN_8bd52141_Rx: PduLength=8, SysTPduToFrameMappingRef=EngineData_12
        EngineData_12_oFD1_CAN_9648d350_Rx: PduLength=8
        Suspension_Dev_Data_1_oFD1_CAN_80ff2e4e_Tx: PduLength=16
        Suspension_Dev_Data_2_oFD1_CAN_63b45877_Tx: PduLength=16, SysTPduToFrameMappingRef=Suspension_Dev_Data_2
        Suspension_Dev_Data_2_oFD1_CAN_6bc8954d_Tx: PduLength=16
        SymKeyFuncGWM_ECG_FD1_Tp_oFD1_CAN_f4deecab_Rx: PduLength=64, SysTPduToFrameMappingRef=SymKeyFuncGWM_ECG_FD1_Tp
        SymKeyFuncGWM_ECG_FD1_Tp_oFD1_CAN_20_61264116_Rx: PduLength=8, SysTPduToFrameMappingRef=SymKeyFuncGWM_ECG_FD1_Tp
        SymKeyFuncGWM_ECG_FD1_oFD1_CAN_20_7c82ea3b_Rx: PduLength=7
        SymKeyFuncGWM_ECG_FD1_oFD1_CAN_20_c753180b_Rx: PduLength=7
        SymKeyFuncGWM_ECG_FD1_oFD1_CAN_284a1a4a_Rx: PduLength=62
        SymKeyFuncGWM_ECG_FD1_oFD1_CAN_79ccca29_Rx: PduLength=62
        TripResetSyncMessage_FD1_oFD1_CAN_69fb2151_Rx: PduLength=0
        XCP_Slave_oFD1_CAN_0ac2cbad_Tx: PduLength=64, SysTPduToFrameMappingRef=XCP_Slave
        XCP_Master_oFD1_CAN_ec976ce0_Rx: PduLength=64, SysTPduToFrameMappingRef=XCP_Master
        EngVehicleSpThrottle2_Sc_oFD1_CAN_4191a17d_Rx: PduLength=16
        TorqueDataEngFlags_Sc_oFD1_CAN_49d500a4_Rx: PduLength=16, SysTPduToFrameMappingRef=TorqueDataEngFlags_Sc
        TripResetSyncMessage_FD1_Sc_oFD1_CAN_91deba95_Rx: PduLength=12, SysTPduToFrameMappingRef=TripResetSyncMessage_FD1_Sc
        EngVehicleSpThrottle2_Sc_oFD1_CAN_98d7ab8a_Rx: PduLength=16, SysTPduToFrameMappingRef=EngVehicleSpThrottle2_Sc
        BodyInfo_3_Sc_oFD1_CAN_973545b5_Rx: PduLength=16, SysTPduToFrameMappingRef=BodyInfo_3_Sc
        VehicleOperatingModes_Sc_oFD1_CAN_0c4359e5_Rx: PduLength=16, SysTPduToFrameMappingRef=VehicleOperatingModes_Sc
        TorqueDataEngFlags_Sc_oFD1_CAN_ae2ae55d_Rx: PduLength=16
        TripResetSyncMessage_FD1_Sc_oFD1_CAN_251c9746_Rx: PduLength=12
        BodyInfo_3_Sc_oFD1_CAN_114afbeb_Rx: PduLength=16
        EngBrakeData_Sc_oFD1_CAN_548bfe27_Rx: PduLength=16
        EngBrakeData_Sc_oFD1_CAN_6723975c_Rx: PduLength=16, SysTPduToFrameMappingRef=EngBrakeData_Sc
        EngineData_6_Sc_oFD1_CAN_0e6e7053_Rx: PduLength=16, SysTPduToFrameMappingRef=EngineData_6_Sc
        EngVehicleSpThrottle_Sc_oFD1_CAN_49fe67ad_Rx: PduLength=16
        EngineData_6_Sc_oFD1_CAN_98bbc72e_Rx: PduLength=16
        EngVehicleSpThrottle_Sc_oFD1_CAN_6cb17649_Rx: PduLength=16, SysTPduToFrameMappingRef=EngVehicleSpThrottle_Sc
        Tire_Pressure_Data_Sc_oFD1_CAN_fd25a01d_Rx: PduLength=16, SysTPduToFrameMappingRef=Tire_Pressure_Data_Sc
        Personality_BCM2_Data_Sc_oFD1_CAN_6c1d258b_Rx: PduLength=16, SysTPduToFrameMappingRef=Personality_BCM2_Data_Sc
        Tire_Pressure_Data_Sc_oFD1_CAN_52c487d0_Rx: PduLength=16
        GGCC_Config_Mgmt_ID_1_Sc_oFD1_CAN_1e9697bb_Rx: PduLength=16
        PowertrainData_9_Sc_oFD1_CAN_da46a144_Rx: PduLength=16, SysTPduToFrameMappingRef=PowertrainData_9_Sc
        PowertrainData_9_Sc_oFD1_CAN_33ae25e8_Rx: PduLength=16
        Personality_BCM2_Data_Sc_oFD1_CAN_ccadc08d_Rx: PduLength=16
        GGCC_Config_Mgmt_ID_1_Sc_oFD1_CAN_903eeee8_Rx: PduLength=16, SysTPduToFrameMappingRef=GGCC_Config_Mgmt_ID_1_Sc
        Suspension_Dev_Data_1_oFD1_CAN_d02075b4_Tx: PduLength=16, SysTPduToFrameMappingRef=Suspension_Dev_Data_1
        VehicleOperatingModes_Sc_oFD1_CAN_9b048180_Rx: PduLength=16
        Ride_Leveling_Data_FD1_oFD1_CAN_7a2697f6_Rx: PduLength=8
        Ride_Leveling_Data_FD1_oFD1_CAN_c8977956_Rx: PduLength=8, SysTPduToFrameMappingRef=Ride_Leveling_Data_FD1
        EngineClimateData_Sc_oFD1_CAN_2df9d07d_Rx: PduLength=16
        DesiredTorqBrk_Sc_oFD1_CAN_5785bd4b_Rx: PduLength=16
        EngineClimateData_Sc_oFD1_CAN_c2461e62_Rx: PduLength=16, SysTPduToFrameMappingRef=EngineClimateData_Sc
        ABS_BrkBst_Data_Sc_oFD1_CAN_2642eeca_Rx: PduLength=16
        AirSuspLoad_Data_FD1_oFD1_CAN_850cfa68_Rx: PduLength=8
        Body_Info_9_Sc_oFD1_CAN_22673695_Rx: PduLength=16, SysTPduToFrameMappingRef=Body_Info_9_Sc
        Body_Info_9_oFD1_CAN_0ef95d49_Rx: PduLength=8
        DesiredTorqBrk_Sc_oFD1_CAN_177ad7a5_Rx: PduLength=16, SysTPduToFrameMappingRef=DesiredTorqBrk_Sc
        CGEA_Urea_Strategy_oFD1_CAN_57f0426c_Rx: PduLength=8, SysTPduToFrameMappingRef=CGEA_Urea_Strategy
        ABS_BrkBst_Data_Sc_oFD1_CAN_a3dc7d77_Rx: PduLength=16, SysTPduToFrameMappingRef=ABS_BrkBst_Data_Sc
        BrakeSysFeatures_Sc_oFD1_CAN_ec5a2489_Rx: PduLength=16
        VDM_AutoSar_NetworkMgt_oFD1_CAN_e64079d3_Tx: PduLength=8, SysTPduToFrameMappingRef=VDM_AutoSar_NetworkMgt
        BrakeSnData_3_Sc_oFD1_CAN_9fcb7321_Rx: PduLength=16
        Body_Info_9_Sc_oFD1_CAN_5aad323f_Rx: PduLength=16
        BrakeSnData_3_Sc_oFD1_CAN_d2a9d77a_Rx: PduLength=16, SysTPduToFrameMappingRef=BrakeSnData_3_Sc
        Cluster_Lighting_Rq_FD1_oFD1_CAN_464c86d7_Rx: PduLength=8
        Pitch_Data_Sc_oFD1_CAN_74671fc6_Rx: PduLength=16
        BrakeSysFeatures_2_Sc_oFD1_CAN_e250b735_Rx: PduLength=16
        Body_Info_7_Sc_oFD1_CAN_935362a4_Rx: PduLength=16, SysTPduToFrameMappingRef=Body_Info_7_Sc
        Pitch_Data_oFD1_CAN_6e55c707_Rx: PduLength=8
        AirSuspLoad_Data_FD1_oFD1_CAN_c427b752_Rx: PduLength=8, SysTPduToFrameMappingRef=AirSuspLoad_Data_FD1
        Personality_Data_FD1_oFD1_CAN_4710214d_Rx: PduLength=8, SysTPduToFrameMappingRef=Personality_Data_FD1
        BrakeSysFeatures_Sc_oFD1_CAN_b0267365_Rx: PduLength=16, SysTPduToFrameMappingRef=BrakeSysFeatures_Sc
        BrakeSysFeatures_3_Sc_oFD1_CAN_a5a6d75d_Rx: PduLength=16, SysTPduToFrameMappingRef=BrakeSysFeatures_3_Sc
        Personality_APIM_Data_FD1_oFD1_CAN_366cd0bd_Rx: PduLength=8, SysTPduToFrameMappingRef=Personality_APIM_Data_FD1
        WheelSpeed_Sc_oFD1_CAN_416e8431_Rx: PduLength=16
        BrakeSnData_4_Sc_oFD1_CAN_678b7e42_Rx: PduLength=16, SysTPduToFrameMappingRef=BrakeSnData_4_Sc
        SuspensionRoad_Data_FD1_oFD1_CAN_3c734d30_Rx: PduLength=8
        Personality_Data_FD1_oFD1_CAN_4ed70389_Rx: PduLength=8
        Cluster_Lighting_Rq_FD1_oFD1_CAN_8dcfc28c_Rx: PduLength=8, SysTPduToFrameMappingRef=Cluster_Lighting_Rq_FD1
        WheelSpeed_Sc_oFD1_CAN_21bce9ce_Rx: PduLength=16, SysTPduToFrameMappingRef=WheelSpeed_Sc
        SuspensionRoad_Data_FD1_oFD1_CAN_ec1b1900_Rx: PduLength=8, SysTPduToFrameMappingRef=SuspensionRoad_Data_FD1
        BrakeSysFeatures_2_Sc_oFD1_CAN_99c63455_Rx: PduLength=16, SysTPduToFrameMappingRef=BrakeSysFeatures_2_Sc
        Body_Info_7_oFD1_CAN_10306dfa_Rx: PduLength=8
        Pitch_Data_Sc_oFD1_CAN_6610557f_Rx: PduLength=16, SysTPduToFrameMappingRef=Pitch_Data_Sc
        Personality_SUMA_Data_FD1_oFD1_CAN_6853d756_Rx: PduLength=8, SysTPduToFrameMappingRef=Personality_SUMA_Data_FD1
        EngineClimateData_oFD1_CAN_22377c97_Rx: PduLength=8
        BrakeSysFeatures_3_Sc_oFD1_CAN_3fc66eb0_Rx: PduLength=16
        Mc_Send_Signals_2_FD1_oFD1_CAN_957cf58b_Rx: PduLength=8, SysTPduToFrameMappingRef=Mc_Send_Signals_2_FD1
        Personality_APIM_Data_FD1_oFD1_CAN_e406d98c_Rx: PduLength=8
        PowertrainData_10_oFD1_CAN_b761f2f5_Rx: PduLength=8, SysTPduToFrameMappingRef=PowertrainData_10
        Body_Info_7_Sc_oFD1_CAN_a04b3e8f_Rx: PduLength=16
        CGEA_Urea_Strategy_oFD1_CAN_8ef2601b_Rx: PduLength=8
        PowertrainData_10_oFD1_CAN_bf906052_Rx: PduLength=8
        Mc_Send_Signals_2_FD1_oFD1_CAN_bffaafb8_Rx: PduLength=8
        Personality_SUMA_Data_FD1_oFD1_CAN_40a62656_Rx: PduLength=8
        BrakeSnData_4_Sc_oFD1_CAN_e2b87579_Rx: PduLength=16
    EcucGeneral:
      CPUType = CPU32Bit
      SizeOfInt = Size32Bit
      ByteOrder = LITTLE_ENDIAN
      BitOrder = LSB_to_MSB
      AtomicBitAccessInBitfield = false
      AtomicVariableAccess = Atomic32BitAccess
      SizeOfEnum = Size32Bit
      SizeOfROMPointer = Size32Bit
      SizeOfRAMPointer = Size32Bit
      BitFieldDataType = INT
      StructAlignment = Auto
      ArrayAlignment = Auto
      StructInArrayAlignment = Auto
      DummyFunction = false
      EcuCSafeBswChecks = false
      DummyStatement = false
      DummyStatementKind = None
      ConditionalGenerating = true
      EcucBswImplementationCodeType = EcuCSourceCode
      EcuCUseStdReturnTypeForRte = false
      PostbuildLoadable: AlignmentFillPattern=0, PBROMStartAddress=0, PBRAMStartAddress=0, PBROMEndAddress=0, PBRAMEndAddress=0
      BswInitialization
        78 x InitFunction:
          BswM_InitMemory: Header=BswM.h, InitPhase=INIT_MEMORY, ModuleRef=BswM
          BswM_PreInit: Header=BswM.h, InitPhase=INIT_ONE, ConfigType=BswM_ConfigType, ConfigPtrName=BswM_Config_Ptr, ConfigPtrClass=BSWM_INIT_DATA, ModuleRef=BswM
          BswM_Init: Header=BswM.h, InitPhase=NO_INIT, ConfigType=BswM_ConfigType, ConfigPtrName=BswM_Config_Ptr, ConfigPtrClass=BSWM_INIT_DATA, ModuleRef=BswM
          CanSM_InitMemory: Header=CanSM_EcuM.h, InitPhase=INIT_MEMORY, ModuleRef=CanSM
          CanSM_Init: Header=CanSM_EcuM.h, InitPhase=INIT_TWO_SM, ConfigType=CanSM_ConfigType, ConfigPtrName=CanSM_Config_Ptr, ConfigPtrClass=CANSM_INIT_DATA, ModuleRef=CanSM
          ComM_InitMemory: Header=ComM.h, InitPhase=INIT_MEMORY, ModuleRef=ComM
          ComM_Init: Header=ComM.h, InitPhase=INIT_TWO_POST_NVMREADALL, ModuleRef=ComM
          Com_InitMemory: Header=Com.h, InitPhase=INIT_MEMORY, ModuleRef=Com
          Com_Init: Header=Com.h, InitPhase=INIT_TWO_COM, ConfigType=Com_ConfigType, ConfigPtrName=Com_Config_Ptr, ConfigPtrClass=COM_INIT_DATA, ModuleRef=Com
          Det_Init: Header=Det.h, InitPhase=INIT_ZERO, ConfigType=Det_ConfigType, ConfigPtrName=Det_Config_Ptr, ConfigPtrClass=DET_INIT_DATA, ModuleRef=Det
          Det_InitMemory: Header=Det.h, InitPhase=INIT_MEMORY, ModuleRef=Det
          EcuM_Init: Header=EcuM.h, InitPhase=NO_INIT, ConfigType=EcuM_PbConfigType, ConfigPtrName=EcuM_Config_Ptr, ConfigPtrClass=ECUM_INIT_DATA, ModuleRef=EcuM
          PduR_InitMemory: Header=PduR.h, InitPhase=INIT_MEMORY, ModuleRef=PduR
          PduR_Init: Header=PduR.h, InitPhase=INIT_TWO_COM, ConfigType=PduR_PBConfigType, ConfigPtrName=PduR_Config_Ptr, ConfigPtrClass=PDUR_INIT_DATA, ModuleRef=PduR
          Dem_PreInit: Header=Dem.h, InitPhase=INIT_ZERO, ConfigType=Dem_ConfigType, ConfigPtrName=Dem_Config_Ptr, ConfigPtrClass=DEM_INIT_DATA, ModuleRef=Dem
          Dem_InitMemory: Header=Dem.h, InitPhase=INIT_MEMORY, ModuleRef=Dem
          Dem_Init: Header=Dem.h, InitPhase=INIT_TWO_POST_NVMREADALL, ConfigType=Dem_ConfigType, ConfigPtrName=Dem_Config_Ptr, ConfigPtrClass=DEM_INIT_DATA, ModuleRef=Dem
          CanIf_InitMemory: Header=CanIf.h, InitPhase=INIT_MEMORY, ModuleRef=CanIf
          CanIf_Init: Header=CanIf.h, InitPhase=INIT_TWO_IF, ConfigType=CanIf_ConfigType, ConfigPtrName=CanIf_Config_Ptr, ConfigPtrClass=CANIF_INIT_DATA, ModuleRef=CanIf
          Can_Init: Header=Can.h, InitPhase=INIT_TWO_DRV, ConfigType=Can_ConfigType, ConfigPtrName=Can_Config_Ptr, ConfigPtrClass=CAN_INIT_DATA, ModuleRef=Can
          Can_InitMemory: Header=Can.h, InitPhase=INIT_MEMORY, ModuleRef=Can
          Adc_Init: Header=Adc.h, InitPhase=INIT_ONE_LATE, ConfigType=Adc_ConfigType, ConfigPtrName=&Adc_Config, ConfigPtrClass=const, ModuleRef=Adc
          Port_Init: Header=Port.h, InitPhase=INIT_ONE_EARLY, ConfigType=Port_ConfigType, ConfigPtrName=&Port_Config, ConfigPtrClass=const, ModuleRef=Port
          Spi_Init: Header=Spi.h, InitPhase=INIT_ONE, ConfigType=Spi_ConfigType, ConfigPtrName=&Spi_Config, ConfigPtrClass=const, ModuleRef=Spi
          Mcu_Init: Header=Mcu.h, InitPhase=INIT_ONE_EARLY, ConfigType=Mcu_ConfigType, ConfigPtrName=&Mcu_Config, ConfigPtrClass=const, AdditionalInitCode=Mcu_InitClock(0); while (MCU_PLL_LOCKED != Mcu_GetPllStatus()); Mcu_DistributePllClock();, ModuleRef=Mcu
          Dma_Init: Header=Dma.h, InitPhase=INIT_ONE, ConfigType=Dma_ConfigType, ConfigPtrName=&Dma_Config, ConfigPtrClass=const, ModuleRef=Dma
          Rte_InitMemory: Header=Rte_Main.h, InitPhase=INIT_MEMORY, ModuleRef=Rte
          SchM_Init: Header=Rte_Main.h, InitPhase=NO_INIT, ModuleRef=Rte
          Rte_StartTiming: Header=Rte_Main.h, InitPhase=NO_INIT, ModuleRef=Rte
          Rte_Start: Header=Rte_Main.h, InitPhase=INIT_THREE, ModuleRef=Rte
          CanTp_InitMemory: Header=CanTp.h, InitPhase=INIT_MEMORY, ModuleRef=CanTp
          CanTp_Init: Header=CanTp.h, InitPhase=INIT_TWO_TP, ConfigType=CanTp_ConfigType, ConfigPtrName=CanTp_Config_Ptr, ConfigPtrClass=CANTP_INIT_DATA, ModuleRef=CanTp
          Dcm_InitMemory: Header=Dcm.h, InitPhase=INIT_MEMORY, ModuleRef=Dcm
          Dcm_Init: Header=Dcm.h, InitPhase=INIT_TWO_POST_NVMREADALL, ConfigType=Dcm_ConfigType, ConfigPtrName=NULL_PTR, ConfigPtrClass=DCM_CONST, ModuleRef=Dcm
          NvM_Init: Header=NvM.h, InitPhase=INIT_TWO_SYS, ModuleRef=NvM
          Fee_Init: Header=Fee.h, InitPhase=INIT_ONE, ConfigType=Fee_ConfigType, ConfigPtrName=&Fee_Config, ConfigPtrClass=const, ModuleRef=Fee
          Fls_17_Dmu_Init: Header=Fls_17_Dmu.h, InitPhase=INIT_ONE, ConfigType=Fls_17_Dmu_ConfigType, ConfigPtrName=&Fls_17_Dmu_Config, ConfigPtrClass=const, ModuleRef=Fls
          Xcp_InitMemory: Header=Xcp.h, InitPhase=INIT_MEMORY, ModuleRef=Xcp
          Xcp_Init: Header=Xcp.h, InitPhase=INIT_TWO_TP, ModuleRef=Xcp
          WdgM_Init: Header=WdgM.h, InitPhase=INIT_TWO_IF, ConfigType=WdgM_ConfigType, ConfigPtrName=&WdgMConfig_Mode0_core0, ConfigPtrClass=WDGM_APPL_CONST, ModuleRef=WdgM
          Gpt_Init: Header=Gpt.h, InitPhase=INIT_ONE, ConfigType=Gpt_ConfigType, ConfigPtrName=&Gpt_Config, ConfigPtrClass=const, ModuleRef=Gpt
          CanTrcv_30_Tja1145_Init: Header=CanTrcv_30_Tja1145.h, InitPhase=INIT_TWO_TRCV, ConfigType=CanTrcv_30_Tja1145_ConfigType, ConfigPtrName=CanTrcv_30_Tja1145_Config_Ptr, ConfigPtrClass=CANTRCV_30_TJA1145_INIT_DATA, ModuleRef=CanTrcv
          CanTrcv_30_Tja1145_InitMemory: Header=CanTrcv_30_Tja1145.h, InitPhase=INIT_MEMORY, ModuleRef=CanTrcv
          CryIf_Init: Header=CryIf.h, InitPhase=INIT_TWO_IF, ModuleRef=CryIf
          CryIf_InitMemory: Header=CryIf.h, InitPhase=INIT_MEMORY, ModuleRef=CryIf
          Crypto_30_SecAccessFord_Init: Header=Crypto_30_SecAccessFord.h, InitPhase=INIT_TWO_DRV, ModuleRef=FordCrypto
          Crypto_30_SecAccessFord_InitMemory: Header=Crypto_30_SecAccessFord.h, InitPhase=INIT_MEMORY, ModuleRef=FordCrypto
          Crypto_30_LibCv_InitMemory: Header=Crypto_30_LibCv.h, InitPhase=INIT_MEMORY, ModuleRef=Crypto
          Crypto_30_LibCv_Init: Header=Crypto_30_LibCv.h, InitPhase=INIT_TWO_DRV, ModuleRef=Crypto
          Csm_InitMemory: Header=Csm.h, InitPhase=INIT_MEMORY, ModuleRef=Csm
          Csm_Init: Header=Csm.h, InitPhase=INIT_TWO_SYS, ModuleRef=Csm
          RamTst_InitMemory: Header=RamTst.h, InitPhase=INIT_MEMORY, ModuleRef=RamTst
          RamTst_Init: Header=RamTst.h, InitPhase=INIT_THREE, ModuleRef=RamTst
          CddOvtp_InitMemory: Header=CddOvtp.h, InitPhase=INIT_MEMORY, ModuleRef=CddOvtp
          CddOvtp_Init: Header=CddOvtp.h, InitPhase=INIT_TWO_POST_NVMREADALL, ConfigType=CddOvtp_ConfigType, ConfigPtrName=NULL_PTR, ConfigPtrClass=CddOvtp_INIT_DATA, ModuleRef=CddOvtp
          vMemAccM_Init: Header=vMemAccM.h, InitPhase=INIT_TWO_DRV, ModuleRef=vMemAccM
          vMemAccM_InitMemory: Header=vMemAccM.h, InitPhase=INIT_MEMORY, ModuleRef=vMemAccM
          vMem_30_Tc3xxInf01_InitMemory: Header=vMem_30_Tc3xxInf01.h, InitPhase=INIT_MEMORY, ModuleRef=vMem
          vMem_30_Tc3xxInf01_Init: Header=vMem_30_Tc3xxInf01.h, InitPhase=INIT_TWO_MCAL, ConfigType=vMem_30_Tc3xxInf01_ConfigType, ConfigPtrName=vMem_30_Tc3xxInf01_Config_Ptr, ConfigPtrClass=VMEM_30_TC3XXINF01_INIT_DATA, ModuleRef=vMem
          vSwUpdM_InitMemory: Header=vSwUpdM.h, InitPhase=INIT_MEMORY, ModuleRef=vSwUpdM
          vSwUpdM_Init: Header=vSwUpdM.h, InitPhase=INIT_TWO_SYS, ConfigType=vSwUpdM_ConfigType, ConfigPtrName=vSwUpdM_Config_Ptr, ConfigPtrClass=VSWUPDM_INIT_DATA, ModuleRef=vSwUpdM
          CddOsph_Init: Header=CddOsph.h, InitPhase=INIT_TWO_POST_NVMREADALL, ConfigType=CddOsph_ConfigType, ConfigPtrName=NULL_PTR, ConfigPtrClass=CddOsph_INIT_DATA, ModuleRef=CddOsph
          CddOsph_InitMemory: Header=CddOsph.h, InitPhase=INIT_MEMORY, ModuleRef=CddOsph
          Wdg_17_Scu_Init: Header=Wdg_17_Scu.h, InitPhase=INIT_ONE, ConfigType=Wdg_17_Scu_ConfigType, ConfigPtrName=&Wdg_17_Scu_Config_0, ConfigPtrClass=const, ModuleRef=Wdg
          CddOsoh_Init: Header=CddOsoh.h, InitPhase=INIT_TWO_POST_NVMREADALL, ConfigType=CddOsoh_ConfigType, ConfigPtrName=NULL_PTR, ConfigPtrClass=CddOsoh_INIT_DATA, ModuleRef=CddOsoh
          CddOsoh_InitMemory: Header=CddOsoh.h, InitPhase=INIT_MEMORY, ModuleRef=CddOsoh
          CanXcp_InitMemory: Header=CanXcp.h, InitPhase=INIT_MEMORY, ModuleRef=Xcp
          CanXcp_Init: Header=CanXcp.h, InitPhase=INIT_TWO_TP, ConfigType=CanXcp_ConfigType, ConfigPtrName=NULL_PTR, ConfigPtrClass=CANXCP_CONST, ModuleRef=Xcp
          SecOC_Init: Header=SecOC.h, InitPhase=INIT_TWO_COM, ConfigType=SecOC_ConfigType, ConfigPtrName=SecOC_Config_Ptr, ConfigPtrClass=SECOC_INIT_DATA, ModuleRef=SecOC
          SecOC_InitMemory: Header=SecOC.h, InitPhase=INIT_MEMORY, ModuleRef=SecOC
          vKeyMFord_InitMemory: Header=vKeyMFord.h, InitPhase=INIT_MEMORY, ModuleRef=vKeyMFord
          vKeyMFord_Init: Header=vKeyMFord.h, InitPhase=INIT_TWO_SYS, ModuleRef=vKeyMFord
          FvM_InitMemory: Header=FvM.h, InitPhase=INIT_MEMORY, ModuleRef=FvM
          FvM_Init: Header=FvM.h, InitPhase=INIT_TWO_POST_NVMREADALL, ConfigType=FvM_ConfigType, ConfigPtrName=FvM_Config_Ptr, ConfigPtrClass=FVM_INIT_DATA, ModuleRef=FvM
          Crypto_30_vHsm_InitMemory: Header=Crypto_30_vHsm.h, InitPhase=INIT_MEMORY, ModuleRef=Crypto_30_vHsm
          Crypto_30_vHsm_Init: Header=Crypto_30_vHsm.h, InitPhase=INIT_TWO_DRV, ModuleRef=Crypto_30_vHsm
          vFeeAcc_Init: Header=vFeeAcc.h, InitPhase=INIT_TWO_IF, ModuleRef=vFeeAcc
          NoInit: Header=noFile, InitPhase=NO_INIT, ModuleRef=vMem_30_Blocking
    EcucHardware
      3 x EcucCoreDefinition:
        EcucCoreDefinition_Core{0..2}: EcucCoreId={0..2}
    EcucPartitionCollection
      4 x EcucPartition, all with EcucPartitionBswModuleExecution=false, PartitionCanBeRestarted=false, ASIL=QM:
        EcucPartition: EcucPartitionSoftwareComponentInstanceRef=CddOsoh, EcucPartitionSoftwareComponentInstanceRef=BswM
        EcucPartition_Core0_QM: EcucPartitionSoftwareComponentInstanceRef=COMPOSITIONTYPE.Os_OsCore0_swc, EcucPartitionSoftwareComponentInstanceRef=EcuM, EcucPartitionSoftwareComponentInstanceRef=ComM
        EcucPartition_Core1_QM: EcucPartitionSoftwareComponentInstanceRef=COMPOSITIONTYPE.Os_OsCore1_swc
        EcucPartition_Core2_QM: EcucPartitionSoftwareComponentInstanceRef=COMPOSITIONTYPE.Os_OsCore2_swc
